## components/find_my_transport/Kconfig
```kconfig
menu "Find My transport"

    config FIND_MY_TRANSPORT_MODEM_ID
        hex "Public modem identifier"
        default 0x4E555453
        help
            Four-byte public routing identifier (default ASCII "NUTS").
            It is embedded in every candidate public key and is not a secret.
            Configure the receiver with the same hexadecimal value.

    config FIND_MY_TRANSPORT_ADV_INTERVAL_MS
        int "BLE advertising interval (milliseconds)"
        range 20 10240
        default 1000
        help
            Interval between non-connectable BLE advertisements for a symbol.
            ESP32 rounds this value to BLE's 0.625 ms controller units.

    config FIND_MY_TRANSPORT_SYMBOL_DWELL_MS
        int "Dwell time per 2-bit symbol (milliseconds)"
        range 20 60000
        default 1600
        help
            Time each candidate key remains on air. Keep this at least as long
            as the advertising interval so every symbol gets an opportunity to
            be transmitted. Four symbols encode each source byte.

    config FIND_MY_TRANSPORT_HEADER_REPEATS
        int "FMN1 header copies per body pass"
        range 1 32
        default 8
        help
            Number of times the fixed 40-symbol FMN1 header is aired during
            each complete body pass. Copies are distributed across the pass,
            allowing receivers to learn the exact frame length reliably even
            when relay coverage is intermittent.

endmenu
```

## main/Kconfig.projbuild
```kconfig
menu "Find My Nuts"

    choice FIND_MY_BOARD
        prompt "Wallet board"
        default BOARD_HELTEC_V3 if IDF_TARGET_ESP32S3
        default BOARD_TDISPLAY

        config BOARD_TDISPLAY
            bool "Original TTGO T-Display (ESP32, ST7789)"
            depends on IDF_TARGET_ESP32

        config BOARD_HELTEC_V3
            bool "Heltec WiFi LoRa 32 V3 (ESP32-S3, SSD1306)"
            depends on IDF_TARGET_ESP32S3
    endchoice

    config NUCULA_SELFTEST_ON_BOOT
        bool "Run crypto/keyset self-tests at every boot"
        default n
        help
            Runs the BDHKE/DLEQ/NUT-13 crypto vectors and the keyset-id
            derivation self-tests during app_main. Costs roughly a second
            of boot time; the same tests are always available at runtime
            via the 'selftest' console command.

    config NUCULA_MAX_DISTRIBUTION_PROOFS
        int "Maximum proofs in one custom mint distribution"
        range 1 128
        default 32
        help
            Bounds d=<distribution> parsing and the RAM/NVS used by a single
            mint operation. A one-satoshi giveaway should stay deliberately
            small; later Find My activations export one proof at a time.

    config FIND_MY_OUTBOX_CAPACITY
        int "Durable one-proof token slots"
        range 1 64
        default 16
        help
            Number of serialized one-proof Cashu tokens retained in NVS.
            Completed entries remain stored because Find My has no delivery
            acknowledgement and forgetting a bearer token can lose funds.

    config FIND_MY_MAX_TOKEN_BYTES
        int "Maximum serialized bytes per one-proof token"
        range 256 4096
        default 1536
        help
            Maximum cashuB string length accepted into one outbox slot.

endmenu
```
